## boards/shields/keyboard_squared/Kconfig.defconfig
```kconfig
if SHIELD_KEYBOARD_SQUARED_LEFT

config ZMK_KEYBOARD_NAME
    default "keyboard-squared"

config ZMK_SPLIT_ROLE_CENTRAL
    default y

endif # SHIELD_KEYBOARD_SQUARED_LEFT

if SHIELD_KEYBOARD_SQUARED_LEFT || SHIELD_KEYBOARD_SQUARED_RIGHT

config ZMK_SPLIT
    default y

endif # SHIELD_KEYBOARD_SQUARED_LEFT || SHIELD_KEYBOARD_SQUARED_RIGHT
```

## boards/shields/keyboard_squared/Kconfig.shield
```kconfig
config SHIELD_KEYBOARD_SQUARED_LEFT
    def_bool $(shields_list_contains,keyboard_squared_left)

config SHIELD_KEYBOARD_SQUARED_RIGHT
    def_bool $(shields_list_contains,keyboard_squared_right)
```
