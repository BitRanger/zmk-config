// This file was generated from a template. Edit it to match your keyboard.
// See https://zmk.dev/docs/development/hardware-integration/new-shield for more
// instructions.

#include "kb_sq.dtsi"

&kscan {
    // Replace these comments with the GPIO pins in the matrix for the left side.
    // See https://zmk.dev/docs/development/hardware-integration/new-shield#shield-overlays
    col-gpios
        = <&gpio1 10 GPIO_ACTIVE_HIGH>
        , <&gpio1 9 GPIO_ACTIVE_HIGH>
        , <&gpio1 8 GPIO_ACTIVE_HIGH>
        , <&gpio1 7 GPIO_ACTIVE_HIGH>
        , <&gpio1 6 GPIO_ACTIVE_HIGH>
        , <&gpio1 5 GPIO_ACTIVE_HIGH>
        ;
};

//&kscan {
//    // Replace these comments with the GPIO pins in the matrix for the left side.
//    // See https://zmk.dev/docs/development/hardware-integration/new-shield#shield-overlays
//    col-gpios
//        = <&pro_micro 0 GPIO_ACTIVE_HIGH>
//        , <&pro_micro 0 GPIO_ACTIVE_HIGH>
//        ;
//};
