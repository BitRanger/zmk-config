## boards/shields/kb_sq/Kconfig.defconfig
```kconfig
if SHIELD_KB_SQ_LEFT

config ZMK_KEYBOARD_NAME
    default "kb-sq"

config ZMK_SPLIT_ROLE_CENTRAL
    default y

endif # SHIELD_KB_SQ_LEFT

if SHIELD_KB_SQ_LEFT || SHIELD_KB_SQ_RIGHT

config ZMK_SPLIT
    default y

endif # SHIELD_KB_SQ_LEFT || SHIELD_KB_SQ_RIGHT
```

## boards/shields/kb_sq/Kconfig.shield
```kconfig
config SHIELD_KB_SQ_LEFT
    def_bool $(shields_list_contains,kb_sq_left)

config SHIELD_KB_SQ_RIGHT
    def_bool $(shields_list_contains,kb_sq_right)
```
